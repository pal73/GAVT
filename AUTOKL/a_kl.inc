_rus_buff:
	.DB  0xFD,0xA2,0xFF,0xAA,0xC8,0xAC,0xAD,0xAE
	.DB  0xAF,0xB0,0xB1,0xD7,0x69,0xB4,0xB5,0xFE
	.DB  0xDF,0xB5,0xCC,0xBA,0xC9,0xBC,0xBD,0xBE
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	.DB  0xC7
	.DEF _ind=R6
_char0:
	.DB  0x8,0xC,0xE,0xF,0xE,0xC,0x8,0x0
_char1:
	.DB  0x6,0x9,0x9,0x6,0x0,0x0,0x0,0x0
_char2:
	.DB  0x0,0x2,0x7,0xF,0x1F,0x1F,0xE,0x0
_char2_:
	.DB  0x0,0x4,0xE,0x1F,0x1F,0x1F,0xE,0x0
_char2__:
	.DB  0x0,0x8,0x1C,0x1E,0x1F,0x1F,0xE,0x0
_char3:
	.DB  0x4,0xE,0x1F,0x0,0x0,0x0,0x0,0x0
_char4:
	.DB  0x0,0x0,0xF,0x8,0x8,0x8,0xF,0x0
_char5:
	.DB  0x10,0x18,0x1F,0x19,0x11,0x1,0x1F,0x0
	.DEF _but=R8
	.DEF _adc_cnt=R9
	.DEF _adc_cnt1=R10
	.DEF _sub_ind=R11
	.DEF _sub_ind1=R12
	.DEF _index_set=R13
	.DEF _cnt_ibat=R14
_temper_table:
	.DW  0x13EE,0x15EE,0x180C,0x1A5B,0x1CC8,0x1F5C,0x2217,0x24FA
	.DW  0x2804,0x2B36,0x2E85,0x3205,0x35A3,0x3968,0x3D55,0x4169
	.DW  0x45A4,0x49FE,0x4E88,0x51E1,0x55FF
_const_of_adc:
	.DB  0x0,0x3,0x2,0x1
_597:
	.DB  0x80,0xC0
_0:
	.DB  0x0,0x21,0x20,0x20,0x20,0x20,0x20,0x20
	.DB  0x20,0x40,0x20,0x20,0x20,0x20,0x20,0x20
	.DB  0x20,0x0,0x23,0x20,0x20,0x20,0x20,0x20
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	.DB  0xC5,0xCD,0x20,0x20,0x20,0x0

;REGISTER BIT VARIABLES INITIALIZATION
__REG_BIT_VARS:
	.DW  0x0000
	.DW  0x0008

__GLOBAL_INI_TBL:
	.DW  0x04
	.DW  0x02
	.DW  __REG_BIT_VARS*2

	.DW  0x01
	.DW  _lcd_buffer
	.DW  _0*2

	.DW  0x02
	.DW  __base_y
	.DW  _597*2

	.DW  0
