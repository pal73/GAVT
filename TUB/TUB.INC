_rus_buff:
	.DB  0xFD,0xA2,0xFF,0xAA,0xC8,0xAC,0xAD,0xAE
	.DB  0xAF,0xB0,0xB1,0xD7,0x69,0xB4,0xB5,0xFE
	.DB  0xDF,0xB5,0xCC,0xBA,0xC9,0xBC,0xBD,0xBE
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	.DB  0xC7
	.DEF _ind=R6
_char0:
	.DB  0x8,0xC,0xE,0xF,0xE,0xC,0x8,0x0
_char1:
	.DB  0x6,0x9,0x9,0x6,0x0,0x0,0x0,0x0
_char2:
	.DB  0x10,0x10,0x10,0x1E,0x11,0x11,0x1E,0x0
_char3:
	.DB  0x4,0xE,0x1F,0x0,0x0,0x0,0x0,0x0
_char4:
	.DB  0x0,0x0,0xF,0x8,0x8,0x8,0xF,0x0
_char5:
	.DB  0x10,0x18,0x1F,0x19,0x11,0x1,0x1F,0x0
	.DEF _but=R7
	.DEF _adc_cnt=R8
	.DEF _adc_cnt1=R9
	.DEF _sub_ind=R10
	.DEF _sub_ind1=R11
	.DEF _index_set=R12
	.DEF _cnt_ibat=R13
	.DEF _cnt_ubat=R14
_354:
	.DB  0x80,0xC0
_0:
	.DB  0x0,0x20,0x20,0x20,0x20,0x20,0x20,0x24
	.DB  0x20,0x20,0x20,0x20,0x20,0x20,0x20,0x20
	.DB  0x20,0x0,0x20,0x55,0x3D,0x20,0x20,0x2C
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	.DB  0x20,0x2E,0x21,0xC0,0x0

;REGISTER BIT VARIABLES INITIALIZATION
__REG_BIT_VARS:
	.DW  0x0000
	.DW  0x0008

__GLOBAL_INI_TBL:
	.DW  0x04
	.DW  0x02
	.DW  __REG_BIT_VARS*2

	.DW  0x01
	.DW  _lcd_buffer
	.DW  _0*2

	.DW  0x02
	.DW  __base_y
	.DW  _354*2

	.DW  0
